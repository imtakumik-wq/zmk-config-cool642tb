#include <input/processors.dtsi>

&trackball_listener {
    input-processors = <&zip_xy_scaler 1 2>;

    layer3_scroll {
        layers = <3>;
        input-processors = <&zip_xy_scaler 1 1>
                           <&zip_xy_to_scroll_mapper>;
    };
};
