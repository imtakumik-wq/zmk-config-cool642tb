/ {
    trackball_listener {
        compatible = "zmk,input-listener";
        device = <&trackball>;
        input-processors = <&zip_temp_layer 4 2000>;

        scroll_layer {
            layers = <3>;
            input-processors = <&zip_xy_to_scroll_mapper>;
        };
    };
};
